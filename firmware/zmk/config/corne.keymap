// Corne 42-key wireless (nice_nano_v2) configuration.
// Wraps the shared base.keymap with outer columns for the 6th column per side.

#define CONFIG_WIRELESS

// Define the 42-key layout wrapper. The base.keymap provides 5-column inner
// keys per side (LT/RT, LM/RM, LB/RB) and 2 inner thumb keys per side (LH/RH).
// This macro adds the outer column and extra thumb for each side.
#define ZMK_BASE_LAYER(name, LT, RT, LM, RM, LB, RB, LH, RH)                 \
    ZMK_LAYER(                                                                 \
        name,                                                                  \
        &kp F13   LT RT &kp F14                                               \
        &kp F15   LM RM &kp F16                                               \
        &kp F17   LB RB &kp F18                                               \
        &kp F19   LH RH &kp F20                                               \
    )

#include "zmk-helpers/key-labels/42.h"
#include "base.keymap"
